## bsp/qemu-vexpress-a9/Kconfig
```kconfig
mainmenu "RT-Thread Project Configuration"

BSP_DIR := .

RTT_DIR := ../..

PKGS_DIR := packages

source "$(RTT_DIR)/Kconfig"
osource "$PKGS_DIR/Kconfig"
source "$(BSP_DIR)/drivers/Kconfig"
osource "$(BSP_DIR)/applications/myPilot_lite/Kconfig"
```

## bsp/qemu-vexpress-a9/applications/myPilot_lite/Kconfig
```kconfig
# This is an menconfig file for displaying the myPilot_lite project in the RT-Thread configuration menu.

menuconfig BSP_USING_MYPILOT_LITE
    bool "Enable myPilot_lite flight-control practice project"
    default y
    help
        Enable the minimal myPilot_lite scaffold used to port and study
        StarryPilot on RT-Thread v5.x with the QEMU vexpress-a9 BSP.

if BSP_USING_MYPILOT_LITE

config MYPILOT_LITE_LOOP_HZ
    int "Initial flight loop frequency (Hz)"
    range 1 1000
    default 250

config MYPILOT_USING_DPS368
    bool "Automatically register DPS368 barometer"
    depends on RT_USING_I2C
    default n
    help
        Register the DPS368 as an RT-Thread device during application init.
        Keep this disabled for qemu-vexpress-a9 unless an I2C sensor model is
        provided. The driver is still compiled and can be registered manually.

if MYPILOT_USING_DPS368

config MYPILOT_DPS368_DEVICE_NAME
    string "DPS368 RT-Thread device name"
    default "baro0"

config MYPILOT_DPS368_I2C_BUS_NAME
    string "DPS368 I2C bus name"
    default "i2c1"

config MYPILOT_DPS368_I2C_ADDRESS
    hex "DPS368 7-bit I2C address"
    range 0x76 0x77
    default 0x77

endif
endif
```
